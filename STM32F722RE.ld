MEMORY
{
  ITCM(xrw)        : ORIGIN = 0x00000000, LENGTH = 16k

  DTCM(xrw)        : ORIGIN = 0x20000000, LENGTH = 64k
  SRAM_1(xrw)      : ORIGIN = 0x20010000, LENGTH = 176k
  SRAM_2(xrw)      : ORIGIN = 0x2003c000, LENGTH = 16k

  /* CONF(xr)         : ORIGIN = 0x08004000, LENGTH = 48k */
  /* LOADER(xr)       : ORIGIN = 0x08010000, LENGTH = 64k */
  /* PROGA(xr)        : ORIGIN = 0x08020000, LENGTH = 384k */
  /* PROGI(xr)        : ORIGIN = 0x00220000, LENGTH = 384k */

  BL_AXIM(xr)      : ORIGIN = 0x08000000, LENGTH = 16k
  FW_AXIM(xr)      : ORIGIN = 0x08004000, LENGTH = 496k

  BL_ITCM(xr)      : ORIGIN = 0x00200000, LENGTH = 16k
  FW_ITCM(xr)      : ORIGIN = 0x00204000, LENGTH = 496k

  FLASH_AXIM(xr)   : ORIGIN = 0x08000000, LENGTH = 512k
  FLASH_0_AXIM(xr) : ORIGIN = 0x08000000, LENGTH = 16k
  FLASH_1_AXIM(xr) : ORIGIN = 0x08004000, LENGTH = 16k
  FLASH_2_AXIM(xr) : ORIGIN = 0x08008000, LENGTH = 16k
  FLASH_3_AXIM(xr) : ORIGIN = 0x0800C000, LENGTH = 16k
  FLASH_4_AXIM(xr) : ORIGIN = 0x08010000, LENGTH = 64k
  FLASH_5_AXIM(xr) : ORIGIN = 0x08020000, LENGTH = 128k
  FLASH_6_AXIM(xr) : ORIGIN = 0x08040000, LENGTH = 128k
  FLASH_7_AXIM(xr) : ORIGIN = 0x08060000, LENGTH = 128k

  FLASH_ITCM(xr)   : ORIGIN = 0x00200000, LENGTH = 512k
  FLASH_0_ITCM(xr) : ORIGIN = 0x00200000, LENGTH = 16k
  FLASH_1_ITCM(xr) : ORIGIN = 0x00204000, LENGTH = 16k
  FLASH_2_ITCM(xr) : ORIGIN = 0x00208000, LENGTH = 16k
  FLASH_3_ITCM(xr) : ORIGIN = 0x0020C000, LENGTH = 16k
  FLASH_4_ITCM(xr) : ORIGIN = 0x00210000, LENGTH = 64k
  FLASH_5_ITCM(xr) : ORIGIN = 0x00220000, LENGTH = 128k
  FLASH_6_ITCM(xr) : ORIGIN = 0x00240000, LENGTH = 128k
  FLASH_7_ITCM(xr) : ORIGIN = 0x00260000, LENGTH = 128k
}
